## arch/arm/mach-msm/lge/Kconfig.board
```kconfig
#
# Inlcude the specific Kconfig file for LGE board
#

# LGE alessi Model
source "arch/arm/mach-msm/lge/alessi/Kconfig"

# LGE gelato Model
source "arch/arm/mach-msm/lge/gelato/Kconfig"

# LGE muscat Model
source "arch/arm/mach-msm/lge/muscat/Kconfig"

# LGE pecan Model
source "arch/arm/mach-msm/lge/pecan/Kconfig"

# LGE thunderg Model
source "arch/arm/mach-msm/lge/thunderg/Kconfig"

# LGE univa Model
source "arch/arm/mach-msm/lge/univa/Kconfig"
```

## arch/arm/mach-msm/lge/gelato/Kconfig
```kconfig
config MACH_MSM7X27_GELATO
	depends on ARCH_MSM7X27
	depends on !MSM_STACKED_MEMORY
	select MACH_LGE
	select LGE_4G_DDR
	bool "MSM7x27 GELATO Global"
	help
	 Support for the LGE MSM7x27 GELATO Global board.
```

## arch/arm/mach-msm/lge/muscat/Kconfig
```kconfig
config MACH_MSM7X27_MUSCAT
	depends on ARCH_MSM7X27
	depends on !MSM_STACKED_MEMORY
	select MACH_LGE
	bool "MSM7x27 MUSCAT"
	help
	 Support for the LGE MSM7x27 MUSCAT board.
```

## arch/arm/mach-msm/lge/pecan/Kconfig
```kconfig
config MACH_MSM7X27_PECAN
	depends on ARCH_MSM7X27
	depends on !MSM_STACKED_MEMORY
	select MACH_LGE
	bool "MSM7x27 PECAN Global"
	help
	 Support for the LGE MSM7x27 PECAN Global board.
```

## arch/arm/mach-msm/lge/univa/Kconfig
```kconfig
config MACH_MSM7X27_UNIVA
	depends on ARCH_MSM7X27
	depends on !MSM_STACKED_MEMORY
	select MACH_LGE
	select LGE_4G_DDR
	bool "MSM7x27 UNIVA Global"
	help
	 Support for the LGE MSM7x27 UNIVA Global board.
```

## drivers/input/touchscreen/mcs7000/Kconfig
```kconfig
menu "Melfas MCS7000 Touchscreen"

config TOUCHSCREEN_MCS7000
	tristate "Melfas MCS7000 support"
	default n
	depends on I2C
	help
		Say Y here if you have a MCS7000 touchscreen, usually found
		on some mobile phones.
		
		To compile this driver as a module, say M here and the driver
		will be called mcs7000.

config MCS7000_MULTITOUCH
	bool "Multitouch support"
	default y
	depends on TOUCHSCREEN_MCS7000
	help
		The MCS7000 supports 2-point multitouch. Select this option
		to enable such support.

choice
	prompt "Supporting platform"
	default MCS7000_PECAN
	depends on TOUCHSCREEN_MCS7000
	help
		For this driver to work correctly, it needs some platform-dependent
		functions that are not abstracted by the kernel. You can select the
		underlying platform here.

	config MCS7000_PECAN
		bool "LG Pecan (P350)"
		depends on TOUCHSCREEN_MCS7000
		help
			Select this option to enable this device to work with the LG
			Pecan board, also known commercially as the LG Optimus Me or
			simply as the P350.
			
			You can otherwise say N here.
endchoice

endmenu
```

## drivers/video/msm/Kconfig
```kconfig
source "drivers/video/msm/vidc/Kconfig"

config FB_MSM
	tristate
	depends on FB && ARCH_MSM
	select FB_CFB_FILLRECT
	select FB_CFB_COPYAREA
	select FB_CFB_IMAGEBLIT
	default y

config FB_MSM_LCDC
	bool "Support for integrated LCD controller in qsd8x50"
	depends on FB_MSM && MSM_MDP31
	default y

config FB_MSM_NO_MDP_PIPE_CTRL
	depends on FB_MSM_OVERLAY
	bool "Do not use mdp_pipe_ctrl"
	---help---
	  Saying 'Y' here obsoletes the mdp_pipe_ctrl function,
	  which was used to control mdp-related clocks. MDP4 vsync-driven
	  screen updates will use a different clock control mechanism if
	  this is selected.

config FB_MSM_VSYNC_SYSFS
	depends on FB_MSM_OVERLAY
	bool "Use sysfs_notify for vsync notification"
	default y
	---help---
	  Saying 'Y' here will use sysfs_notify instead of the default uevent for
	  notification of vsync events to userspace.

config FB_MSM_OVERLAY0_WRITEBACK
	depends on FB_MSM_OVERLAY
        bool "MDP overlay0 write back mode enable"
	---help---
	  Support for MDP4 OVERLAY0 write back mode

config FB_MSM_LCDC_MIPI_PANEL_AUTO_DETECT
	bool "LCDC + MIPI Panel Auto Detect"
	select FB_MSM_LCDC_AUTO_DETECT
	select FB_MSM_LCDC_SAMSUNG_WSVGA
	select FB_MSM_LCDC_AUO_WVGA
	select FB_MSM_LCDC_SAMSUNG_OLED_PT
	select FB_MSM_MIPI_TOSHIBA_VIDEO_WVGA_PT
	select FB_MSM_MIPI_TOSHIBA_VIDEO_WSVGA_PT
	select FB_MSM_MIPI_RENESAS_VIDEO_FWVGA_PT
	select FB_MSM_MIPI_RENESAS_CMD_FWVGA_PT
	select FB_MSM_MIPI_NOVATEK_VIDEO_QHD_PT
	select FB_MSM_MIPI_NOVATEK_CMD_QHD_PT
	select FB_MSM_MIPI_SIMULATOR_VIDEO
	---help---
	  Support for LCDC + MIPI panel auto detect


config FB_MSM_OVERLAY1_WRITEBACK
        depends on FB_MSM_OVERLAY
        bool "MDP overlay1 write back mode enable"
        ---help---
          Support for MDP4 OVERLAY1 write back mode

config FB_MSM_WRITEBACK_MSM_PANEL
	depends on FB_MSM_OVERLAY
        bool "MDP overlay write back panel enable"
	---help---
	  Support for MDP4 OVERLAY write back mode
```
